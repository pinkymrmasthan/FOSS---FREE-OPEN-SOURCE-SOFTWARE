#include <SPI.h>          
#include <Adafruit_GFX.h>
#include <MCUFRIEND_kbv.h>

#include <math.h>


MCUFRIEND_kbv tft;

#define LCD_CS A3 // Chip Select goes to Analog 3
#define LCD_CD A2 // Command/Data goes to Analog 2
#define LCD_WR A1 // LCD Write goes to Analog 1
#define LCD_RD A0 // LCD Read goes to Analog 0
//#define LCD_RESET -1 // Can alternately just connect to Arduino's reset pin


float l1=0,l2=0,l3=0,l4=0,l5=0;


String inString = "";
int cnt=0;


char lightString [4];
String str; 

  float ah; //absolute humidity = water vapor density in g/m*3
  float rh; // relative humidity in %
  float t; //temperature in celsius
  float td; //dew point in celsius
  float tf; //temperature in fahrenheit
  float tdf; // dew point temperature in fahrenheit

int lightIntensity = 0;


#define BLACK   0x0000
#define BLUE    0x001F
#define RED     0xF800
#define GREEN   0x07E0
#define CYAN    0x07FF
#define MAGENTA 0xF81F
#define YELLOW  0xFFE0
#define WHITE   0xFFFF

#define RED2RED 0
#define GREEN2GREEN 1
#define BLUE2BLUE 2
#define BLUE2RED 3
#define GREEN2RED 4
#define RED2GREEN 5

uint32_t runTime = -99999;       // time for next update
int reading1 = 0; // Value to be displayed
int d = 0; // Variable used for the sinewave test waveform
boolean alert = 0;
int8_t ramp = 1;
int tesmod =0;



uint8_t sun[] = {
  0x00, 0x00, 0x00, 0x00, 0x00, 0x00, 0x00, 0x00, 0x00, 0x00, 0x00, 0x00, 0x00, 0x00, 0x00, 0x00,
  0x00, 0x00, 0x00, 0x00, 0x00, 0x00, 0x00, 0x00, 0x00, 0x00, 0x00, 0x00, 0x00, 0x00, 0x00, 0xc0,
  0x00, 0x00, 0x00, 0x00, 0x00, 0x00, 0xc0, 0x00, 0x00, 0x00, 0x00, 0x00, 0x00, 0xc0, 0x00, 0x00,
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  0x00, 0x00, 0x00, 0x00, 0x00, 0x00, 0x00, 0x00, 0x00, 0x00, 0x00, 0x00, 0x00, 0x00
};

uint8_t partlyCloudyDay[]  = {
  0x00, 0x00, 0x00, 0x00, 0x00, 0x00, 0x00, 0x00, 0x00, 0x00, 0x00, 0x00, 0x00, 0x00, 0x00, 0x00,
  0x00, 0x00, 0x00, 0x00, 0x00, 0x00, 0x00, 0x00, 0x00, 0x00, 0x00, 0x00, 0x00, 0x00, 0xc0, 0x00,
  0x00, 0x00, 0x00, 0x00, 0x00, 0xc0, 0x00, 0x00, 0x00, 0x00, 0x00, 0x00, 0xc0, 0x00, 0x00, 0x00,
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  0x00, 0x00, 0x00, 0x00, 0x00, 0x00, 0x00, 0x00, 0x00, 0x00, 0x00, 0x00, 0x00, 0x00
};

uint8_t cloud[] = {
  0x00, 0x00, 0x00, 0x00, 0x00, 0x00, 0x00, 0x00, 0x00, 0x00, 0x00, 0x00, 0x00, 0x00, 0x00, 0x00,
  0x00, 0x00, 0x00, 0x00, 0x00, 0x00, 0x00, 0x00, 0x00, 0x00, 0x00, 0x00, 0x00, 0x00, 0x00, 0x00,
  0x00, 0x00, 0x00, 0x00, 0x00, 0x00, 0x00, 0x00, 0x00, 0x00, 0x00, 0x00, 0x00, 0x00, 0x00, 0x00,
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  0x00, 0x00, 0x00, 0x00, 0x00, 0x00, 0x00, 0x00, 0x00, 0x00, 0x00, 0x00, 0x00, 0x00
};

uint8_t rain[]  = {
  0x00, 0x00, 0x00, 0x00, 0x00, 0x00, 0x00, 0x00, 0x00, 0x00, 0x00, 0x00, 0x00, 0x00, 0x00, 0x00,
  0x00, 0x00, 0x00, 0x00, 0x00, 0x00, 0x00, 0x00, 0x00, 0x00, 0x00, 0x00, 0x00, 0x00, 0x00, 0x00,
  0x00, 0x00, 0x00, 0x00, 0x00, 0x1f, 0xc0, 0x00, 0x00, 0x00, 0x00, 0x00, 0x7f, 0xf0, 0x00, 0x00,
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  0x00, 0x00, 0x00, 0x00, 0x00, 0x00, 0x00, 0x00, 0x00, 0x00, 0x00, 0x00, 0x00, 0x00
};

uint8_t snow[]  = {
  0x00, 0x00, 0x00, 0x00, 0x00, 0x00, 0x00, 0x00, 0x00, 0x00, 0x00, 0x00, 0x00, 0x00, 0x00, 0x00,
  0x00, 0x00, 0x00, 0x00, 0x00, 0x00, 0x00, 0x00, 0x00, 0x00, 0x00, 0x00, 0x00, 0x00, 0x00, 0x00,
  0x00, 0x00, 0x00, 0x00, 0x00, 0x1f, 0xc0, 0x00, 0x00, 0x00, 0x00, 0x00, 0x7f, 0xf0, 0x00, 0x00,
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  0x00, 0x00, 0x80, 0x00, 0x08, 0x00, 0x00, 0x00, 0x00, 0x00, 0x00, 0x00, 0x00, 0x00
};







void setup()
   {
    Serial.begin(9600);
    //Serial.println("DHTxx test!");
    tft.reset(); //Reset LCD to begin
    uint16_t id = tft.readID();
    //tft.begin(0x1580);
    tft.begin(id);
    tft.setRotation(1); // Set Rotation at 0 degress (default)

    tft.fillScreen(BLACK); //Set Background Color with BLACK
   
displaydata();
}
void loop(){
  while (Serial.available() > 0) {

    char c = Serial.read();
//Serial.print(c);
     if (c == '\n' || c == '\r') {
               if(cnt >=8){
                            Serial.println(inString);
                            status_filter(inString);
                            status_filter1(inString);
                            status_filter2(inString);
                            status_filter3(inString);
                            inString = "";
                            cnt=0;
                           }
                      else
                           { 
                            inString = "";
                            cnt=0;
                            }
                 }
                else
                 {
                 inString +=c;
                 cnt++;
                  }
      
  
    }
}

void status_filter(String buff)
  {
    if(buff[0]=='$')
    if(buff[2]=='G')
    if(buff[4]=='L')
    if(buff[7]=='T')
    if(buff[10]=='H')
    if(buff[13]=='#')
    //$1G3L50T33H74#
    {
      
         String temp1=buff.substring(1,2);
         String temp2=buff.substring(3,4);
         String temp3=buff.substring(5,7);
         String temp4=buff.substring(8,10);
         String temp5=buff.substring(11,13);
     l1=temp1.toFloat();
          l2=temp2.toFloat();
          l3=temp3.toFloat();
          l4=temp4.toFloat();
          l5=temp5.toFloat();
         
         Serial.println(l1);
         Serial.println(l2);
         Serial.println(l3);
         Serial.println(l4);
         Serial.println(l5);
         displaydata();
   }
  }
void status_filter1(String buff)
  {
  
    if(buff[0]=='$')
    if(buff[3]=='G')
    if(buff[6]=='L')
    if(buff[9]=='T')
    if(buff[12]=='H')
    if(buff[15]=='#')
    //$1G3L50T33H74#
    {
      
         String temp1=buff.substring(1,3);
         String temp2=buff.substring(4,6);
         String temp3=buff.substring(7,9);
         String temp4=buff.substring(10,12);
         String temp5=buff.substring(13,15);
     l1=temp1.toFloat();
          l2=temp2.toFloat();
          l3=temp3.toFloat();
          l4=temp4.toFloat();
          l5=temp5.toFloat();
         
         Serial.println(l1);
         Serial.println(l2);
         Serial.println(l3);
         Serial.println(l4);
         Serial.println(l5);
         displaydata();
   }
  }
void status_filter2(String buff)
  {
  
    if(buff[0]=='$')
    if(buff[3]=='G')
    if(buff[5]=='L')
    if(buff[8]=='T')
    if(buff[11]=='H')
    if(buff[14]=='#')
    //$1G3L50T33H74#
    {
      
         String temp1=buff.substring(1,3);
         String temp2=buff.substring(4,5);
         String temp3=buff.substring(6,8);
         String temp4=buff.substring(9,11);
         String temp5=buff.substring(12,14);
   l1=temp1.toFloat();
          l2=temp2.toFloat();
          l3=temp3.toFloat();
          l4=temp4.toFloat();
          l5=temp5.toFloat();
         
         Serial.println(l1);
         Serial.println(l2);
         Serial.println(l3);
         Serial.println(l4);
         Serial.println(l5);
         displaydata();
   }
  }
void status_filter3(String buff)
  {
 
    if(buff[0]=='$')
    if(buff[2]=='G')
    if(buff[5]=='L')
    if(buff[8]=='T')
    if(buff[11]=='H')
    if(buff[14]=='#')
    //$1G3L50T33H74#
    {
      
         String temp1=buff.substring(1,2);
         String temp2=buff.substring(3,5);
         String temp3=buff.substring(6,8);
         String temp4=buff.substring(9,11);
         String temp5=buff.substring(12,14);
          l1=temp1.toFloat();
          l2=temp2.toFloat();
          l3=temp3.toFloat();
          l4=temp4.toFloat();
          l5=temp5.toFloat();
         
         Serial.println(l1);
         Serial.println(l2);
         Serial.println(l3);
         Serial.println(l4);
         Serial.println(l5);
         displaydata();
   }
  }

void displaydata() {

  
   float h = random(40,70);
  float t = random(40,70);
  float f = random(40,70);
  float hif = random(40,70);
  float hic = random(40,70);
  


  lightIntensity = random(40,70);
  
  lightIntensity = map(lightIntensity, 1025, 20, 0, 98);

  str = String(lightIntensity)+"%";
  str.toCharArray(lightString,5);

  float tempC = 0;

  float tempF = 0;

  

  ah = (6.112 * pow(2.71828, ((17.67 * t) / (243.5 + t))) * rh * 2.1674) / (273.15 + t);

  

  int xpos = 0, ypos = 5, gap = 4, radius = 52;
    // Draw a large meter
    xpos = 320/2 - 150, ypos = 15, gap = 100, radius = 50;
    
    ringMeter( l4,0,90, 0,0,radius,"TEMPERATURE",GREEN ); // Draw analogue meter

    ringMeter( l5,0,150, 108,0,radius,"HUMIDITY",GREEN ); // Draw analogue meter

    ringMeter(l3,0,100, 215,0,radius,"LIGHT",GREEN ); // Draw analogue meter

    ringMeter(l1, 0,40, 0,120,radius,"CO2 GAS",GREEN ); // Draw analogue meter

    ringMeter(l2, 0,40, 108,120,radius,"LPG GAS",GREEN ); // Draw analogue meter

    tft.setCursor(245, 130);  
  tft.setTextSize (1);
  tft.setTextColor ( YELLOW , BLACK);
  tft.print("Air Quality");

  tft.setCursor (142,210); // Print the dew point
  tft.setTextSize (1);
  tft.setTextColor (GREEN,BLACK);
  tft.print (l2);
  tft.setTextSize (1);
  tft.setTextColor (GREEN,BLACK);
  tft.print (" % ");
  tesmod=1;

  tft.setCursor(37, 210);  
  tft.setTextSize (1);
  tft.setTextColor ( YELLOW , BLACK);
  tft.print (l1);
  //tft.setCursor(250, 50);  
  tft.setTextSize (1);
  tft.setTextColor ( YELLOW , BLACK);
  tft.print ("% ");

  tft.setCursor (32, 90); // Print temperature from DHT sensor
  tft.setTextSize (1);
  tft.setTextColor (GREEN, BLACK);
  tft.print (l4); 
   tft.setTextSize (1);
  tft.setTextColor (GREEN, BLACK);
  tft.print (" C ");
  tesmod = 1;


  tft.setCursor (247, 90); // Print the Humidity
  tft.setTextSize (1);
  tft.setTextColor (GREEN, BLACK);
  tft.print (l3);
  tft.setTextSize (1);
  tft.setTextColor (GREEN, BLACK);
  tft.print (" % ");
  tesmod = 1;

  if((h)>0 &&  (h)<55 )
  {
  tft.drawBitmap(245,150, sun,50,50,YELLOW,BLACK);
  } else 

  if((h)>=55 &&  (h)<80 )
  {
  tft.drawBitmap(245,150, cloud,50,50,WHITE,BLACK);
  
  } else


  if((h)>=80 &&  (h)<100 )
  {
  tft.drawBitmap(245,150, rain,50,50,BLUE,BLACK);
  
  } 

 
  

  
  

  

if (millis() - runTime >= 1000) { // Execute every 500ms
  runTime = millis();
    
   
}
  Serial.print("Temperature: ");
  Serial.print(l4);
  Serial.println(" *C ");

  Serial.print("Humidity: ");
  Serial.print(l5);
  Serial.println(" %\t");
  Serial.print("Light: ");
  Serial.print(l3);
  Serial.println(" % ");
  Serial.print("Co2 Gas :");
  Serial.print(l1);
  Serial.println(" % ");
  Serial.print("LPG Gas");
  Serial.print(l2);
  Serial.println(" % ");
  Serial.println();
  
 // delay(3000);
}

void ringMeter(int value, int vmin, int vmax, int x, int y, int r, char *units, byte scheme)
{
  // Minimum value of r is about 52 before value text intrudes on ring
  // drawing the text first is an option
  
  x += r; y += r;   // Calculate coords of centre of ring
  int w = r / 3;    // Width of outer ring is 1/4 of radius 
  int angle = 150;  // Half the sweep angle of meter (300 degrees)
  int v = map(value, vmin, vmax, -angle, angle); // Map the value to an angle v
  byte seg = 3; // Segments are 3 degrees wide = 100 segments for 300 degrees
  byte inc = 6; // Draw segments every 3 degrees, increase to 6 for segmented ring
  // Variable to save "value" text colour from scheme and set default
  int colour = GREEN;
 
  // Draw colour blocks every inc degrees
  for (int i = -angle+inc/2; i < angle-inc/2; i += inc) {
    // Calculate pair of coordinates for segment start
    float sx = cos((i - 90) * 0.0174532925);
    float sy = sin((i - 90) * 0.0174532925);
    uint16_t x0 = sx * (r - w) + x;
    uint16_t y0 = sy * (r - w) + y;
    uint16_t x1 = sx * r + x;
    uint16_t y1 = sy * r + y;

    // Calculate pair of coordinates for segment end
    float sx2 = cos((i + seg - 90) * 0.0174532925);
    float sy2 = sin((i + seg - 90) * 0.0174532925);
    int x2 = sx2 * (r - w) + x;
    int y2 = sy2 * (r - w) + y;
    int x3 = sx2 * r + x;
    int y3 = sy2 * r + y;

    if (i < v) { // Fill in coloured segments with 2 triangles
      switch (scheme) {
        case 0: colour = GREEN; break; // Fixed colour
        case 1: colour = RED; break; // Fixed colour
        case 2: colour = BLUE; break; // Fixed colour
        case 3: colour = rainbow(map(i, -angle, angle, 0, 127)); break; // Full spectrum blue to red
        case 4: colour = rainbow(map(i, -angle, angle, 70, 127)); break; // Green to red (high temperature etc)
        case 5: colour = rainbow(map(i, -angle, angle, 127, 63)); break; // Red to green (low battery etc)
        default: colour = GREEN; break; // Fixed colour
      }
      tft.fillTriangle(x0, y0, x1, y1, x2, y2, colour);
      tft.fillTriangle(x1, y1, x2, y2, x3, y3, colour);
      //text_colour = colour; // Save the last colour drawn
    }
    else // Fill in blank segments
    {
      tft.fillTriangle(x0, y0, x1, y1, x2, y2, RED);
      tft.fillTriangle(x1, y1, x2, y2, x3, y3, BLACK);
    }
  }
  // Convert value to a string
  char buf[10];
  byte len = 2; if (value > 999) len = 4;
  dtostrf(value, len, 0, buf);
  buf[len] = ' '; buf[len] = 0; // Add blanking space and terminator, helps to centre text too!
  // Set the text colour to default
  tft.setTextSize(1);

  if(value>9){
  tft.setTextColor(CYAN,BLACK);
  tft.setCursor(x-25,y-10);tft.setTextSize(3);
  tft.print(buf);}
  if(value<10){
  tft.setTextColor(colour,BLACK);
  tft.setCursor(x-25,y-10);tft.setTextSize(3);
  tft.print(buf);}

  
  tft.setTextColor(CYAN,BLACK);
  
  tft.setCursor(x-20,y+55);tft.setTextSize(1);
  tft.print(units); // Units display
  
  // Calculate and return right hand side x coordinate
  return x + r;
}

// #########################################################################
// Return a 16 bit rainbow colour
// #########################################################################
unsigned int rainbow(byte value)
{
  // Value is expected to be in range 0-127
  // The value is converted to a spectrum colour from 0 = blue through to 127 = red

  byte red = 0; // Red is the top 5 bits of a 16 bit colour value
  byte green = 0;// Green is the middle 6 bits
  byte blue = 0; // Blue is the bottom 5 bits
  byte quadrant = value / 32;

  if (quadrant == 0) {
    blue = 31;
    green = 2 * (value % 32);
    red = 0;
  }
  if (quadrant == 1) {
    blue = 31 - (value % 32);
    green = 63;
    red = 0;
  }
  if (quadrant == 2) {
    blue = 0;
    green = 63;
    red = value % 32;
  }
  if (quadrant == 3) {
    blue = 0;
    green = 63 - 2 * (value % 32);
    red = 31;
  }
  return (red << 11) + (green << 5) + blue;
}

// #########################################################################
// Return a value in range -1 to +1 for a given phase angle in degrees
// #########################################################################
float sineWave(int phase) {
  return sin(phase * 0.0174532925);
}
